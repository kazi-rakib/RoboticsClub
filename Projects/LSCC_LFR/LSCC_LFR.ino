#include "U8glib.h"
#include <EEPROM.h>
U8GLIB_SSD1306_128X64 u8g(U8G_I2C_OPT_DEV_0 | U8G_I2C_OPT_NO_ACK | U8G_I2C_OPT_FAST);  // Fast I2C / TWI

#define rmf 2
#define rmb 4
#define lmf 5
#define lmb 6
//EnA and EnB
#define rms 3 //in1
#define lms 9  //in2

// 'New Project (1)', 128x17px
const unsigned char epd_bitmap_New_Project__1_[] PROGMEM = {
  0x00, 0x00, 0x00, 0x00, 0x00, 0x00, 0x00, 0x00, 0x00, 0x00, 0x00, 0x00, 0x00, 0x00, 0x00, 0x00,
  0x00, 0xff, 0xff, 0xff, 0xff, 0xff, 0xff, 0xff, 0xff, 0xff, 0xff, 0xff, 0xff, 0xff, 0xff, 0x80,
  0x01, 0x00, 0x00, 0x00, 0x00, 0x00, 0x00, 0x00, 0x00, 0x00, 0x00, 0x00, 0x00, 0x00, 0x00, 0x40,
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  0x00, 0x00, 0x00, 0x00, 0x00, 0x00, 0x00, 0x00, 0x00, 0x00, 0x00, 0x00, 0x00, 0x00, 0x00, 0x00
};

const int NUM_ITEMS = 6;
const int MAX_ITEM_LENGTH = 20;
char menu_items[NUM_ITEMS][MAX_ITEM_LENGTH] = {
  { "Advance Follow   " },
  { "PID Follow     " },
  { "Calibration     " },
  { "Analog Value  " },
  { "Digital Value " },
  { "Motor Test    " }
};

#define select 10
#define scroll 11
#define led 13

int s[6], sum = 0;
int position[6] = { 1, 2, 3, 4, 5, 6 };
//int threshold = 512;
int sensor;
int lbase = 200, rbase = 200;
int lmotor, rmotor;
float avg, line_prop = 3;
int kp = 70, kd = 100;
int pid_node = 20;
int turn_speed = 200;
int PID;
float pid_error, last_error;
int pos;
char turn;
int base[6] = { 1, 2, 4, 8, 16, 32 };
int i_timer = 100;
bool i_mode = 0;

//Necessary Delays for tuning the robot
#define node_delay 90   //This delay is for to take the bot little bit forward on 90 degree, 30 degree and 30 degree
#define brake_time 20  //This delay is for the brake
#define u_turn_delay 150  //This delay is for the uturn
#define turn_time 50    //This delay is for the turning time 50
#define stop_timer 100
#define tsp 150  //good tsp 120
#define turn_brake 30
#define u_turn_timer 100



int spl = 20;
int spr = 20;
char flag = 's';   //normal flag
char rule = 'l';   //rule flag
char cross = 's';  //cross flag
uint32_t m1, m2;   //timer

int select_clicked = 0;
int scroll_clicked = 0;
int item_selected = 0;
int item_sel_previous;
int item_sel_next;
int current_screen = 0;

int path[50];
int mid[6], maximum[6], minimum[6];

void setup() {
  u8g.setColorIndex(1);
  Serial.begin(9600);
  pinMode(select, INPUT_PULLUP);
  pinMode(scroll, INPUT_PULLUP);
  pinMode(led, OUTPUT);
  //Motor pins
  pinMode(lmf, OUTPUT);
  pinMode(lmb, OUTPUT);
  pinMode(rmf, OUTPUT);
  pinMode(rmb, OUTPUT);
  pinMode(rms, OUTPUT);
  pinMode(lms, OUTPUT);

  for (int i = 0; i < 6; i++) {
    mid[i] = EEPROM.read(i) * 4;
    maximum[i] = EEPROM.read(i + 6) * 4;
    minimum[i] = EEPROM.read(i + 12) * 4;
    Serial.println(String(maximum[i]) + " " + String(mid[i]) + " " + String(minimum[i]));
  }
}

void loop() {
  u8g.firstPage();
  do {
    u8g.setFont(u8g_font_timB18);
    u8g.drawStr(20, 27, "LSCC");
    u8g.drawStr(38, 53, "LFR");
  } while (u8g.nextPage());
  while (button(scroll) == 1) menu();
}